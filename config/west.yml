## config/west.yml
```yaml
manifest:
  remotes:
    - name: zmkfirmware
      url-base: https://github.com/zmkfirmware
    - name: ssbb
      url-base: https://github.com/ssbb
    - name: zettaface
      url-base: https://github.com/zettaface
    - name: petejohanson
      url-base: https://github.com/petejohanson
    - name: badjeff
      url-base: https://github.com/badjeff
    - name: kot149
      url-base: https://github.com/kot149

  projects:
    # https://github.com/zmkfirmware/zmk
    - name: zmk
      remote: zmkfirmware
      revision: main
      import: app/west.yml
      
    # https://github.com/badjeff/zmk-pmw3610-driver
    - name: zmk-pmw3610-driver
      remote: badjeff
      revision: main
      path: modules/zmk-pmw3610-driver-badjeff

    - name: zmk-input-processor-report-rate-limit
      remote: badjeff
      revision: main
      path: modules/zmk-input-processor-report-rate-limit

    - name: zmk-scroll-snap
      remote: kot149
      revision: v1
      path: modules/zmk-scroll-snap
      
  self:
    path: config
```
